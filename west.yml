## west.yml
```yaml
# Copyright (c) 2021 Nordic Semiconductor ASA
# SPDX-License-Identifier: Apache-2.0
manifest:
  remotes:
    - name: zephyrproject-rtos
      url-base: https://github.com/robynsb

  projects:
    - name: zephyr
      remote: zephyrproject-rtos
      revision: i2s-pico
      import:
        # By using name-allowlist we can clone only the modules that are
        # strictly needed by the application.
        name-allowlist:
          - cmsis_6
          - hal_rpi_pico
          - littlefs
```
